# file: 008_02_hal_timer_ext_trig_mode2.ioc
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Mcu.Family=STM32F4
Mcu.Name=STM32F407V(E-G)Tx
Mcu.Package=LQFP100
NVIC.PriorityGroup=NVIC_PRIORITYGROUP_4
PA0-WKUP.Signal=S_TIM2_CH1_ETR
ProjectManager.HeapSize=0x200
ProjectManager.StackSize=0x400
ProjectManager.TargetToolchain=STM32CubeIDE
RCC.AHBFreq_Value=16000000
RCC.APB1Freq_Value=16000000
RCC.APB2Freq_Value=16000000
RCC.CortexFreq_Value=16000000
RCC.HSE_VALUE=25000000
RCC.HSI_VALUE=16000000
RCC.LSE_VALUE=32768
RCC.SYSCLKFreq_VALUE=16000000
RCC.VCOOutputFreq_Value=192000000
SH.S_TIM2_CH1_ETR.0=TIM2_ETR,TriggerSource_ETR
TIM2.Period=30
TIM2.Slave_TriggerFilter=15
VP_TIM2_VS_ControllerModeClock.Mode=Clock Mode
board=custom

// file: Core/Src/main.c
/* USER CODE BEGIN Header */
/**
  ******************************************************************************
  * @file           : main.c
  * @brief          : Main program body
  ******************************************************************************
  * @attention
  *
  * Copyright (c) 2022 STMicroelectronics.
  * All rights reserved.
  *
  * This software is licensed under terms that can be found in the LICENSE file
  * in the root directory of this software component.
  * If no LICENSE file comes with this software, it is provided AS-IS.
  *
  ******************************************************************************
  */
/* USER CODE END Header */
#include "main.h"

TIM_HandleTypeDef htim2;

/* USER CODE BEGIN PV */

uint16_t cnt=0;

/* USER CODE END PV */

void SystemClock_Config(void);
static void MX_GPIO_Init(void);
static void MX_TIM2_Init(void);

int main(void)
{

  /* MCU Configuration--------------------------------------------------------*/

  /* Reset of all peripherals, Initializes the Flash interface and the Systick. */
  HAL_Init();

  /* Configure the system clock */
  SystemClock_Config();

  /* Initialize all configured peripherals */
  MX_GPIO_Init();
  MX_TIM2_Init();
  /* USER CODE BEGIN 2 */

  HAL_TIM_Base_Start_IT(&htim2);  // standart baslattık, adc,dac,timerlarde start,stop getvalue vardır hep

  /*
	NOT: burda ne yaptık amac neydi : video 57 .

	period'u 30 yaptık ,butona yani PA0 a her bastıgımızda deger artacak 30 oldugunda 0 dan tekrar başlayıp saymaya devam eder
	mesela elimizde bir sensor var,sensör'ün frekansı ile alakalı bir sayma işlemi yapacaksak ve
	dışarıdan bir sensor kullancan ,sensorun frekansı 3 kat daha büyük bizim sistemin frekansından ,bu durumda ETRP deki
	prescaler'a bölerek bizim sistemin frekansına düşürebiliriz, sonrada ETRF ile gider ,page 590
	burda buton örneginde yaptıgımız gibi , en fazla 8 e bölebiliriz. 1,2,4,8 sanırım bölme sayıları.

external trigger 2 yi kullanarak ETR kullanacagız ,timer işlemi yapacagız,
harici saat kaynagı etkinleştirildiginde zamanlayıcı kaynagı etr zamanlayıcı
girişi üzerinden beslemen saat sinyalinin aktif kenarı güncellenecektir,

bizim ETR yi asıl kullanma amacımız ,externel clock1 'e göre biraz farklı
externel clock 2 nin external clock 1'e göre en büyük avantajı harici olarak
dışarıdan saglanan saat sinyal frekansının dahili zamanlayıcı saat cekirdek
frekansına eşit veya daha büyük olması  bunu apb1 veri hattı ile timerların
frekansının farkı gibi ,hattın 2 katı timerların frekansıdır.

ETR zamanlayıcı girişinin en büyük avantajı: prescaler degerine sahip olması
etr zamanlayıcı girişi tekrar bir senkronizasyona girmeden önce ön ölcekleyiciye yani
prescaler'a sahiptir, page 590,mesela TI1FP1 lerde yok mesela,
bu prescaler sadece etr de mevcuttur, bu prescaler degeride bizim prescaler
aşamasıasenkrondur,ve asenkron giriş signali frekansının 8 katına kadar bölünmesine
saglıyor,yani bizim girişimize uygulanan frekansı biz 8'e kadar bölebiliriz
mesela bizim elimizde bir signal var ,eger bizim signalin 8 katı büyüklügünde bir
signal frekansı gelirse ben o 8 katı büyüklügündeki signali ben benim elimde olan
signal frekansına cevirebilen özellikte böyle bir girişe sahibizdir.
bu asenkron ön ölceklendir aşaması yani prescaler cıkısı zamanlayıcı sayacına
beslemeden önce yeniden senkronizasyona aşamasına yönlendirilir ve yeniden senkronizasyon
cıkısındada bu ETRF signali denilen bir signal olusur,

ETRP signali zamanlayıcıya beslenen diger asenkron signaller ile aynı kısıtlamaya
sahip frekansı zamanlayıcı dahili cekirdek frekansının 3 katından daha az olmalıdır
TIMx(clk)freq >= 3 * IT * freq

  */

  /* USER CODE END 2 */

  /* Infinite loop */
  while (1)
  {

    /* USER CODE BEGIN 3 */

	  cnt=__HAL_TIM_GetCounter(&htim2);

  }
  /* USER CODE END 3 */
}

void SystemClock_Config(void)
{
  RCC_OscInitTypeDef RCC_OscInitStruct = {0};
  RCC_ClkInitTypeDef RCC_ClkInitStruct = {0};

  /** Configure the main internal regulator output voltage
  */
  __HAL_RCC_PWR_CLK_ENABLE();
  __HAL_PWR_VOLTAGESCALING_CONFIG(PWR_REGULATOR_VOLTAGE_SCALE1);

  /** Initializes the RCC Oscillators according to the specified parameters
  * in the RCC_OscInitTypeDef structure.
  */
  RCC_OscInitStruct.OscillatorType = RCC_OSCILLATORTYPE_HSI;
  RCC_OscInitStruct.HSIState = RCC_HSI_ON;
  RCC_OscInitStruct.HSICalibrationValue = RCC_HSICALIBRATION_DEFAULT;
  RCC_OscInitStruct.PLL.PLLState = RCC_PLL_NONE;
  if (HAL_RCC_OscConfig(&RCC_OscInitStruct) != HAL_OK)
  {
    Error_Handler();
  }

  /** Initializes the CPU, AHB and APB buses clocks
  */
  RCC_ClkInitStruct.ClockType = RCC_CLOCKTYPE_HCLK|RCC_CLOCKTYPE_SYSCLK
                              |RCC_CLOCKTYPE_PCLK1|RCC_CLOCKTYPE_PCLK2;
  RCC_ClkInitStruct.SYSCLKSource = RCC_SYSCLKSOURCE_HSI;
  RCC_ClkInitStruct.AHBCLKDivider = RCC_SYSCLK_DIV1;
  RCC_ClkInitStruct.APB1CLKDivider = RCC_HCLK_DIV1;
  RCC_ClkInitStruct.APB2CLKDivider = RCC_HCLK_DIV1;

  if (HAL_RCC_ClockConfig(&RCC_ClkInitStruct, FLASH_LATENCY_0) != HAL_OK)
  {
    Error_Handler();
  }
}

static void MX_TIM2_Init(void)
{

  TIM_SlaveConfigTypeDef sSlaveConfig = {0};
  TIM_MasterConfigTypeDef sMasterConfig = {0};

  htim2.Instance = TIM2;
  htim2.Init.Prescaler = 0;
  htim2.Init.CounterMode = TIM_COUNTERMODE_UP;
  htim2.Init.Period = 30;
  htim2.Init.ClockDivision = TIM_CLOCKDIVISION_DIV1;
  htim2.Init.AutoReloadPreload = TIM_AUTORELOAD_PRELOAD_DISABLE;
  if (HAL_TIM_Base_Init(&htim2) != HAL_OK)
  {
    Error_Handler();
  }
  sSlaveConfig.SlaveMode = TIM_SLAVEMODE_EXTERNAL1;
  sSlaveConfig.InputTrigger = TIM_TS_ETRF;
  sSlaveConfig.TriggerPolarity = TIM_TRIGGERPOLARITY_NONINVERTED;
  sSlaveConfig.TriggerPrescaler = TIM_TRIGGERPRESCALER_DIV1;
  sSlaveConfig.TriggerFilter = 15;
  if (HAL_TIM_SlaveConfigSynchro(&htim2, &sSlaveConfig) != HAL_OK)
  {
    Error_Handler();
  }
  sMasterConfig.MasterOutputTrigger = TIM_TRGO_RESET;
  sMasterConfig.MasterSlaveMode = TIM_MASTERSLAVEMODE_DISABLE;
  if (HAL_TIMEx_MasterConfigSynchronization(&htim2, &sMasterConfig) != HAL_OK)
  {
    Error_Handler();
  }

}

static void MX_GPIO_Init(void)
{

  /* GPIO Ports Clock Enable */
  __HAL_RCC_GPIOA_CLK_ENABLE();

}

void Error_Handler(void)
{
  __disable_irq();
  while (1)
  {
  }
}
